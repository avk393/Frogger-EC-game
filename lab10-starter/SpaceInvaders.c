// SpaceInvaders.c
// Runs on LM4F120/TM4C123
// Jonathan Valvano and Daniel Valvano
// This is a starter project for the EE319K Lab 10

// Last Modified: 3/6/2015 
// http://www.spaceinvaders.de/
// sounds at http://www.classicgaming.cc/classics/spaceinvaders/sounds.php
// http://www.classicgaming.cc/classics/spaceinvaders/playguide.php
/* This example accompanies the books
   "Embedded Systems: Real Time Interfacing to Arm Cortex M Microcontrollers",
   ISBN: 978-1463590154, Jonathan Valvano, copyright (c) 2014

   "Embedded Systems: Introduction to Arm Cortex M Microcontrollers",
   ISBN: 978-1469998749, Jonathan Valvano, copyright (c) 2014

 Copyright 2015 by Jonathan W. Valvano, valvano@mail.utexas.edu
    You may use, edit, run or distribute this file
    as long as the above copyright notice remains
 THIS SOFTWARE IS PROVIDED "AS IS".  NO WARRANTIES, WHETHER EXPRESS, IMPLIED
 OR STATUTORY, INCLUDING, BUT NOT LIMITED TO, IMPLIED WARRANTIES OF
 MERCHANTABILITY AND FITNESS FOR A PARTICULAR PURPOSE APPLY TO THIS SOFTWARE.
 VALVANO SHALL NOT, IN ANY CIRCUMSTANCES, BE LIABLE FOR SPECIAL, INCIDENTAL,
 OR CONSEQUENTIAL DAMAGES, FOR ANY REASON WHATSOEVER.
 For more information about my classes, my research, and my books, see
 http://users.ece.utexas.edu/~valvano/
 */
// ******* Possible Hardware I/O connections*******************
// Slide pot pin 1 connected to ground
// Slide pot pin 2 connected to PE2/AIN1
// Slide pot pin 3 connected to +3.3V 
// fire button connected to PE0
// special weapon fire button connected to PE1
// 8*R resistor DAC bit 0 on PB0 (least significant bit)
// 4*R resistor DAC bit 1 on PB1
// 2*R resistor DAC bit 2 on PB2
// 1*R resistor DAC bit 3 on PB3 (most significant bit)
// LED on PB4
// LED on PB5

// Backlight (pin 10) connected to +3.3 V
// MISO (pin 9) unconnected
// SCK (pin 8) connected to PA2 (SSI0Clk)
// MOSI (pin 7) connected to PA5 (SSI0Tx)
// TFT_CS (pin 6) connected to PA3 (SSI0Fss)
// CARD_CS (pin 5) unconnected
// Data/Command (pin 4) connected to PA6 (GPIO), high for data, low for command
// RESET (pin 3) connected to PA7 (GPIO)
// VCC (pin 2) connected to +3.3 V
// Gnd (pin 1) connected to ground

#include <stdint.h>
#include "tm4c123gh6pm.h"
#include "ST7735.h"
#include "Random.h"
#include "TExaS.h"
#include "ADC.h"
#include "print.h"


void DisableInterrupts(void); // Disable interrupts
void EnableInterrupts(void); 
void Delay100ms(uint32_t count); // time delay in 0.1 seconds


// *************************** Images ***************************
const unsigned short car1[] = {
 0x0000, 0x0000, 0xFFFF, 0xFFFF, 0xFFFF, 0xFFFF, 0xFFFF, 0xFFFF, 0xFFFF, 0xFFFF, 0xFFFF, 0xFFFF, 0xFFFF, 0xFFFF, 0xFFFF, 0xFFFF,
 0xFFFF, 0xFFFF, 0xFFFF, 0xFFFF, 0xFFFF, 0xFFFF, 0xFFFF, 0xFFFF, 0xFFFF, 0xFFFF, 0xFFFF, 0x0000, 0x0000, 0x0000, 0x0000, 0xFFFF,
 0xFFFF, 0xFFFF, 0xFFFF, 0xFFFF, 0xFFFF, 0xFFFF, 0xFFFF, 0xFFFF, 0xFFFF, 0xFFFF, 0xFFFF, 0xFFFF, 0xFFFF, 0xFFFF, 0xFFFF, 0xFFFF,
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 0xFFFF, 0xFFFF, 0xFFFF, 0xFFFF, 0xFFFF, 0xFFFF, 0xFFFF, 0xFFFF, 0xFFFF, 0xFFFF, 0xFFFF, 0xFFFF, 0x0000, 0x0000,

};



const unsigned short car2[] = {
 0x0000, 0x0000, 0xFFFF, 0xFFFF, 0xFFFF, 0xFFFF, 0xFFFF, 0xFFFF, 0xFFFF, 0xFFFF, 0xFFFF, 0xFFFF, 0xFFFF, 0xFFFF, 0xFFFF, 0xFFFF,
 0xFFFF, 0xFFFF, 0xFFFF, 0xFFFF, 0xFFFF, 0xFFFF, 0xFFFF, 0xFFFF, 0xFFFF, 0xFFFF, 0xFFFF, 0x0000, 0x0000, 0x0000, 0x0000, 0xFFFF,
 0xFFFF, 0xFFFF, 0xFFFF, 0xFFFF, 0xFFFF, 0xFFFF, 0xFFFF, 0xFFFF, 0xFFFF, 0xFFFF, 0xFFFF, 0xFFFF, 0xFFFF, 0xFFFF, 0xFFFF, 0xFFFF,
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 0xFFFF, 0xFFFF, 0xFFFF, 0xFFFF, 0xFFFF, 0xFFFF, 0xFFFF, 0xFFFF, 0xFFFF, 0xFFFF, 0xFFFF, 0xFFFF, 0x0000, 0x0000,

};



const unsigned short car3[] = {
 0x0000, 0x0000, 0xDEDB, 0xFFFF, 0xFFFF, 0xAD75, 0x8430, 0x8C51, 0x8C51, 0xEF7D, 0xF79E, 0xF79E, 0xEF7D, 0xEF5D, 0xEF5D, 0xEF7D,
 0xEF7D, 0xE73C, 0xE73C, 0xE71C, 0x7BEF, 0x8C51, 0x8430, 0xB5B6, 0xF79E, 0xF79E, 0xDEFB, 0x0000, 0x0000, 0x0000, 0x0000, 0xFFDF,
 0xA534, 0xA534, 0x0000, 0x0841, 0x0020, 0x1082, 0x0841, 0xFFFF, 0xFFFF, 0xF79E, 0xEF7D, 0xE73C, 0xEF7D, 0xE73C, 0xEF7D, 0xEF7D,
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 0xFFDC, 0xFFDB, 0xFF9B, 0xFF9B, 0xFF9B, 0xE71B, 0xE71C, 0xE71C, 0xE71C, 0xDEFB, 0xDEFB, 0xE71C, 0x0000, 0x0000,

};

const unsigned short car4[] = {
 0x0000, 0x0000, 0xFFFF, 0xFFFF, 0xFFFF, 0xFFFF, 0xFFFF, 0xFFFF, 0xFFFF, 0xFFFF, 0xFFFF, 0xFFFF, 0xFFFF, 0xFFFF, 0xFFFF, 0xFFFF,
 0xFFFF, 0xFFFF, 0xFFFF, 0xFFFF, 0xFFFF, 0xFFFF, 0xFFFF, 0xFFFF, 0xFFFF, 0xFFFF, 0xFFFF, 0x0000, 0x0000, 0x0000, 0x0000, 0xFFFF,
 0xFFFF, 0xFFFF, 0xFFFF, 0xFFFF, 0xFFFF, 0xFFFF, 0xFFFF, 0xFFFF, 0xFFFF, 0xFFFF, 0xFFFF, 0xFFFF, 0xFFFF, 0xFFFF, 0xFFFF, 0xFFFF,
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 0xFFFF, 0xFFFF, 0xFFFF, 0xFFFF, 0xFFFF, 0xFFFF, 0xFFFF, 0xFFFF, 0xFFFF, 0xFFFF, 0xFFFF, 0xFFFF, 0x0000, 0x0000,

};

const unsigned short frog[] = {
 0x0000, 0x0000, 0x0000, 0x0000, 0x0000, 0x0000, 0x0000, 0x0000, 0x0000, 0x0000, 0x0000, 0x0000, 0x0000, 0x0000, 0x0000, 0x0000,
 0x0000, 0x0000, 0x0000, 0x0000, 0x0000, 0x0000, 0x0000, 0x1964, 0x0000, 0x0000, 0x0000, 0x08E2, 0x0000, 0x0000, 0x0841, 0x340A,
 0x4670, 0x4670, 0x4EB1, 0x4670, 0x458E, 0x3208, 0x4B2D, 0x6C30, 0x6C30, 0x6410, 0x6410, 0x63EF, 0x432D, 0x63F0, 0x6C10, 0x6C10,
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 0x0000, 0x0000, 0x0000, 0x0000, 0x0000, 0x0000, 0x0000, 0x0000, 0x0000, 0x0000, 0x0000, 0x0000, 0x0000, 0x0000,

};

const unsigned short popocar[] = {
 0x0000, 0x0000, 0xEEFC, 0xD6BA, 0xD6BA, 0xE71C, 0xEF7D, 0xFFDF, 0xFFDF, 0xFFFF, 0xFFFF, 0xFFFF, 0xFFFF, 0xFFFF, 0xFFFF, 0xFFFF,
 0xFFFF, 0xFFFF, 0xFFFF, 0xFFFF, 0xFFFF, 0xFFFF, 0xFFFF, 0xC77C, 0xEF5D, 0xEF5D, 0xF79E, 0x0000, 0x0000, 0x0000, 0x0000, 0xFFBE,
 0xF79E, 0xF79E, 0xF79E, 0xFFDF, 0xF7BE, 0xF7BE, 0xF7BE, 0xF7BE, 0xF7BE, 0xF7BE, 0xF7BE, 0xF7BE, 0xF7BE, 0xF7BE, 0xFFBE, 0xFFBE,
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 0xFFFF, 0xFFFF, 0xFFFF, 0xFFFF, 0xFFFF, 0xFFFF, 0xFFFF, 0xFFFF, 0xFFFF, 0xFFFF, 0xFFFF, 0xFFFF, 0x0000, 0x0000,

};


const unsigned short black[] = {
 0x0000, 0x0000, 0x0000, 0x0000, 0x0000, 0x0000, 0x0000, 0x0000, 0x0000, 0x0000, 0x0000, 0x0000, 0x0000, 0x0000, 0x0000, 0x0000,
 0x0000, 0x0000, 0x0000, 0x0000, 0x0000, 0x0000, 0x0000, 0x0000, 0x0000, 0x0000, 0x0000, 0x0000, 0x0000, 0x0000, 0x0000, 0x0000,
 0x0000, 0x0000, 0x0000, 0x0000, 0x0000, 0x0000, 0x0000, 0x0000, 0x0000, 0x0000, 0x0000, 0x0000, 0x0000, 0x0000, 0x0000, 0x0000,
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 0x0000, 0x0000, 0x0000, 0x0000, 0x0000, 0x0000, 0x0000, 0x0000, 0x0000, 0x0000, 0x0000, 0x0000, 0x0000, 0x0000,

};



const unsigned short tree[] = {
 0xFFFF, 0xFFFF, 0xFFFF, 0xFFFF, 0xFFFF, 0xFFFF, 0xFFFF, 0xFFFF, 0xFFFF, 0xFFFF, 0xFFFF, 0xFFFF, 0xFFFF, 0xFFFF, 0xFFFF, 0xFFFF,
 0xFFFF, 0xFFFF, 0xFFFF, 0xFFFF, 0xFFFF, 0xFFFF, 0xFFFF, 0xFFFF, 0xFFFF, 0xFFFF, 0xFFFF, 0xFFFF, 0xFFFF, 0xFFFF, 0xFFFF, 0xFFFF,
 0xFFFF, 0xFFFF, 0xFFFF, 0xFFFF, 0xFFFF, 0xFFFF, 0xFFFF, 0xFFFF, 0xFFFF, 0xFFFF, 0xFFFF, 0xFFFF, 0xFFFF, 0xFFFF, 0xFFFF, 0xFFFF,
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 0xEF5F, 0xFFFF, 0xFFFF, 0xFFFF, 0xFFFF, 0xFFFF, 0xFFFF, 0xFFFF, 0xFFFF, 0xFFFF, 0xFFFF, 0xFFFF, 0xFFFF, 0xFFFF,

};

int delay1;
void PortE_Init(void){
	SYSCTL_RCGCGPIO_R |= 0x00000010;					//activating clock for portE
	delay1 = SYSCTL_RCGCGPIO_R;
	delay1 = SYSCTL_RCGCGPIO_R;
	delay1 = SYSCTL_RCGCGPIO_R;
	GPIO_PORTE_DIR_R &= ~0x03;					//making PE1 & PE0 input for switches
	GPIO_PORTE_DEN_R |= 0x03;
	GPIO_PORTE_AFSEL_R &= ~0x03;
}
// Initialize Port F so PF1, PF2 and PF3 are heartbeats
void PortF_Init(void){
 SYSCTL_RCGCGPIO_R |= 0x00000020;					//activating clock for portF
	delay1 = SYSCTL_RCGCGPIO_R;
	delay1 = SYSCTL_RCGCGPIO_R;
	delay1 = SYSCTL_RCGCGPIO_R;
 GPIO_PORTF_AMSEL_R &= ~0x00;     
 GPIO_PORTF_PCTL_R &= ~0xFF; // regular GPIO function
 GPIO_PORTF_DIR_R |= 0x0E;					// make PF1-3 output
 GPIO_PORTF_AFSEL_R &= ~0x0E;   // disable alt funct on PF1-3
 GPIO_PORTF_DEN_R |= 0x0E;      // enable digital I/O on PF1-3	
}

uint32_t Convert(uint32_t input){
  input=input*249;	
	input = input / 10000;

  return input;
}

void SysTick_Init(void){
		NVIC_ST_CTRL_R = 0;         // disable SysTick during setup
		NVIC_ST_RELOAD_R = 80000-1;// reload value
		NVIC_ST_CURRENT_R = 0;      // any write to current clears it
		NVIC_SYS_PRI3_R = (NVIC_SYS_PRI3_R&0x00FFFFFF)|0x20000000; // priority 1
		NVIC_ST_CTRL_R = 0x07; // enable SysTick with core clock and interrupts
}

struct Cars {
	unsigned short poscarx;
	int poscary;
	const unsigned short *image;
	int direction;      //1 means left
	int speed;
};

typedef struct Cars CarsList;

CarsList Sprite[5]= {
	{99, 137, car1, 1, 0},
	{0, 115, car3, 0, 0},
	{99, 71, car2, 1, 0},
	{0, 49,  car4, 0, 0},
	{99, 27, popocar, 1, 0}
};

int frogposx = 52;
int frogposy = 159;
int up = 0;
int down = 0;
	int x= 52;
	int y = 159;

void ChangeFrogX(int posx){
	if(x < posx){
		x = x + 1;
	}
	else if( x > posx){
		x = x-1;
	}
}

void ChangeFrogY(int posy){
	if( y < posy){
		y = y + 22;
	}
	else if (y > posy){
		y = y - 22;
	}
}

int UpdateCar1X(int carx){
		carx = carx - 1;
	if(carx < 0 ){
		carx = 99;
	}
	return carx;
}

int main(void){
	TExaS_Init();  // set system clock to 80 MHz
	SysTick_Init();
	PortE_Init();
	PortF_Init();
	ADC_Init();
  Random_Init(1);
  Output_Init();
  //ST7735_FillScreen(0x0000);            // set screen to black
	int i;
  //ST7735_DrawBitmap(52, 159, frog, 29,22); // player middle bottom
  //ST7735_FillScreen(0x0000);            // set screen to black
  /*ST7735_SetCursor(1, 1);
  ST7735_OutString("GAME OVER");
  ST7735_SetCursor(1, 2);*/
	EnableInterrupts();
	ST7735_DrawBitmap(59, 93, tree, 29,22);

  while(1){
		int checku = CheckUp();
		int checkd = CheckDown();
		if (checku == 1){
					GPIO_PORTF_DATA_R ^= 0x04;
					ST7735_DrawBitmap(x, y, black, 29,22);
					ChangeFrogY(frogposy);
					Delay100ms(1);
					ST7735_DrawBitmap(x, y, frog, 29,22);
					up = 0;
			}
		
			else if (checkd == 1){
					GPIO_PORTF_DATA_R ^= 0x04;
					ST7735_DrawBitmap(x, y, black, 29,22);
					ChangeFrogY(frogposy);
					Delay100ms(1);
					ST7735_DrawBitmap(x, y, frog, 29,22);
					down = 0;
			}
			
			for(i = 0; x != frogposx; i++){
				ChangeFrogX(frogposx);
				ST7735_DrawBitmap(x, y, frog, 29,22);
			}	
		}			
	}

int CheckUp(void){															//checking if up switch is pressed
	int checkup = 0;
	checkup = GPIO_PORTE_DATA_R & 0x03;
	if(checkup == 0x01){
		if((x> 30 && x< 88 && y == 115) || y <= 10){						//checking if tree is in the way
			frogposy = frogposy;
		}
		else{
		frogposy = frogposy - 22;
		}
		return 1;
	}
	else{
		return 0;}
}

int CheckDown(void){												//checking if down switch is pressed
	int checkdown = 0;
	checkdown = GPIO_PORTE_DATA_R & 0x03;
	if(checkdown == 0x02){
		if((x> 30 && x< 88 && y == 71) || y >= 159){				//checking if tree is in the way
			frogposy  = frogposy;
		}
		else{
		frogposy = frogposy + 22;
		}
		return 1;
	}
	else{
		return 0;}
}
	


void SysTick_Handler(void){
	int prevfrogpos;
	GPIO_PORTF_DATA_R ^= 0x02;
	if(y != 93){															//checking if tree is in the way
		frogposx = ADC_In();											//calculating frog movement x axis with slide pot
		frogposx = Convert(frogposx);
	}
		prevfrogpos = GPIO_PORTE_DATA_R & 0x03;
		/*if(prevfrogpos == 0x01){
			up = 1;
			frogposy = frogposy - 22;
			GPIO_PORTF_DATA_R ^= 0x04;
		}
		else if(prevfrogpos == 0x02){
			down = 1;
			frogposy = frogposy + 22;
			GPIO_PORTF_DATA_R ^= 0x04;
		}*/
		
	GPIO_PORTF_DATA_R ^= 0x02;
}

// You can use this timer only if you learn how it works
void Delay100ms(uint32_t count){uint32_t volatile time;
  while(count>0){
    time = 727240;  // 0.1sec at 80 MHz
    while(time){
	  	time--;
    }
    count--;
  }
}
